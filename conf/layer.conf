## conf/layer.conf
```bitbake
# We have a conf and classes directory, add to BBPATH
BBPATH .= ":${LAYERDIR}"

# We have a recipes-* directories, add to BBFILES
BBFILES += "${LAYERDIR}/recipes-*/*/*.bb \
    ${LAYERDIR}/recipes-*/*/*.bbappend"

BBFILE_COLLECTIONS += "meta-linuxcnc"
BBFILE_PATTERN_meta-linuxcnc = "^${LAYERDIR}/"
BBFILE_PRIORITY_meta-linuxcnc = "6"

LAYERSERIES_COMPAT_meta-linuxcnc = "rocko sumo"
```
